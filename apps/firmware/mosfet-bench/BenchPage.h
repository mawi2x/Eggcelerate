#pragma once
#include <Arduino.h>
// Generated by embed-page.py from site/index.html.
const char kBenchPage[] PROGMEM = R"BENCHHTML(<!doctype html>
<html lang="en">
<meta charset="utf-8">
<meta name="viewport" content="width=device-width, initial-scale=1">
<title>Fan bench · Eggcelerate</title>
<style>
:root{--bg:#f3f4ed;--panel:#fff;--ink:#252b24;--muted:#596254;--line:#d8ddd2;--green:#315b37;--red:#a32929;--soft:#edf2e9;--radius:18px}
*{box-sizing:border-box}body{margin:0;background:var(--bg);color:var(--ink);font:16px/1.55 system-ui,sans-serif}main{max-width:960px;margin:auto;padding:32px 20px 60px}header{display:flex;justify-content:space-between;align-items:center;gap:16px;margin-bottom:32px}.brand{font-size:14px;font-weight:750;letter-spacing:.12em}.tag{border:1px solid var(--line);border-radius:999px;padding:6px 12px;font-size:13px}h1{font-size:clamp(30px,6vw,46px);line-height:1.15;margin:8px 0 12px;letter-spacing:-.035em}h2{font-size:22px;margin:0}p{margin:8px 0 16px}.muted{color:var(--muted)}.intro{max-width:620px}.session{background:var(--ink);color:white;padding:24px;border-radius:var(--radius);margin:28px 0;display:flex;justify-content:space-between;align-items:center;gap:20px}.session p{margin:6px 0 0;color:#e0e5da}.session-actions{display:flex;gap:10px;flex-wrap:wrap}button{font:inherit;font-weight:650;min-height:46px;border:1px solid var(--line);border-radius:10px;padding:10px 16px;background:var(--panel);color:var(--ink);cursor:pointer;touch-action:manipulation}button:hover:enabled{background:var(--soft)}button:disabled{opacity:.5;cursor:not-allowed}button.primary{background:var(--green);border-color:var(--green);color:white}button.danger{background:var(--red);border-color:var(--red);color:white}button:focus-visible,input:focus-visible{outline:3px solid #b68519;outline-offset:3px}.fans{display:grid;grid-template-columns:repeat(2,minmax(0,1fr));gap:20px}.fan{background:var(--panel);border:1px solid var(--line);border-radius:var(--radius);padding:24px}.fan-head{display:flex;justify-content:space-between;align-items:center;gap:12px}.pin{font-size:13px;color:var(--muted)}.reading{font-size:44px;font-weight:700;letter-spacing:-.04em;margin:24px 0 0}.reading small{font-size:16px;font-weight:450;letter-spacing:0}.actions{display:flex;gap:10px;margin:20px 0}.actions button{flex:1}label{display:block;font-size:14px;font-weight:650}input[type=range]{width:100%;margin:12px 0;min-height:32px;accent-color:var(--green)}.pwm-help{font-size:14px;color:var(--muted)}.note{background:var(--soft);border:1px solid var(--line);border-radius:12px;padding:16px;margin-top:24px;font-size:14px}.checklist{padding-left:22px}.checklist li{margin:8px 0}#feedback{min-height:26px;color:var(--red);margin:16px 0}footer{font-size:13px;color:var(--muted);margin-top:28px}#connection{font-weight:650} @media(max-width:640px){.fans{grid-template-columns:1fr}.session{align-items:flex-start;flex-direction:column}.session-actions{width:100%}.session-actions button{flex:1}main{padding-top:20px}.fan{padding:20px}}
</style>
<main>
<header><span class="brand">EGGCELERATE</span><span class="tag">Local hardware bench</span></header>
<section class="intro"><p class="muted">MOSFET / TWO FAN CHANNELS</p><h1>Check the fans.<br>One output at a time.</h1><p class="muted">DeepCool XFAN 120. Each fan is rated at 12 V, 0.07 A and 0.84 W. Start with the upper fan, then the lower fan. Once both switch correctly, turn them on together.</p></section>
<div class="note" id="preview" hidden><strong>Local layout preview.</strong> Controls are disabled here. After flashing, join the ESP32 test Wi-Fi and open <strong>http://192.168.4.1</strong> to control the board.</div>
<section class="session" aria-label="Test session"><div><div id="connection" role="status">Connecting to board…</div><p id="session-text">Outputs have not been confirmed.</p></div><div class="session-actions"><button id="arm" class="primary" disabled>Arm test</button><button id="stop" class="danger" disabled>All off</button></div></section>
<div id="feedback" role="alert"></div>
<section class="fans" aria-label="Fan controls">
<article class="fan" data-channel="upper"><div class="fan-head"><h2>Upper fan</h2><span class="pin">GPIO19</span></div><div class="reading"><span id="upper-value">—</span> <small>output duty</small></div><p class="muted" id="upper-status">Awaiting board</p><div class="actions"><button data-duty="0" disabled>Off</button><button data-duty="100" disabled>Full on</button></div><label for="upper-duty">PWM duty: <output id="upper-choice">100%</output></label><input id="upper-duty" type="range" min="0" max="100" step="5" value="100" disabled><button class="apply" disabled>Apply duty</button><p class="pwm-help">Speed adjustment unlocks after supply PWM is confirmed in the sketch.</p></article>
<article class="fan" data-channel="lower"><div class="fan-head"><h2>Lower fan</h2><span class="pin">GPIO18</span></div><div class="reading"><span id="lower-value">—</span> <small>output duty</small></div><p class="muted" id="lower-status">Awaiting board</p><div class="actions"><button data-duty="0" disabled>Off</button><button data-duty="100" disabled>Full on</button></div><label for="lower-duty">PWM duty: <output id="lower-choice">100%</output></label><input id="lower-duty" type="range" min="0" max="100" step="5" value="100" disabled><button class="apply" disabled>Apply duty</button><p class="pwm-help">Speed adjustment unlocks after supply PWM is confirmed in the sketch.</p></article>
</section>
<section class="note"><strong>What to observe</strong><ol class="checklist"><li>Arm the test with both outputs off. Check that both fans are stopped.</li><li>Switch the upper fan fully on, observe it, then switch it off. Repeat for the lower fan.</li><li>Switch both fully on and check for resets, unstable operation or unusual module heating.</li><li>Use All off. Confirm both stop. After a successful baseline, qualify PWM separately.</li></ol><p>Sessions end after two minutes. Outputs switch off after ten seconds without browser contact. Closing or hiding the page requests All off.</p><p><strong>Output duty describes the signal applied by the ESP32.</strong> It is not measured fan speed, watts or confirmation that a MOSFET switched. This bench has no RPM or current feedback.</p></section>
<footer>Local test only. Disconnect load power before wiring changes. Firmware cannot guarantee an off state during reset; confirm the module’s hardware pull-down/default-off behavior.</footer>
</main>
<script>
'use strict';
let state = null, online = false, busy = false, polling = false, pollRequest = null;
const preview = new URLSearchParams(location.search).has('preview');
const $ = id => document.getElementById(id);
function render() {
  $('arm').disabled = preview || !online || busy || !state?.ready || state.armed;
  $('stop').disabled = preview || !online || busy;
  for (const channel of ['upper','lower']) {
    const card = document.querySelector(`[data-channel="${channel}"]`);
    const enabled = !preview && online && !busy && state?.armed;
    card.querySelectorAll('[data-duty]').forEach(button => button.disabled = !enabled);
    card.querySelector('input').disabled = !enabled || !state?.pwm;
    card.querySelector('.apply').disabled = !enabled || !state?.pwm;
    $(channel+'-value').textContent = online ? state[channel]+'%' : '—';
    $(channel+'-status').textContent = online ? (state[channel] ? 'GPIO output applied. Check fan motion.' : 'GPIO output off. Check fan has stopped.') : 'Output state unknown';
    card.querySelector('.pwm-help').textContent = online && state.pwm ? `Supply PWM enabled at ${state.frequency} Hz. Duty is not an RPM measurement.` : 'Speed adjustment unlocks after supply PWM is confirmed in the sketch.';
  }
  $('connection').textContent = preview ? 'Preview only' : online ? 'Board connected' : 'Board unavailable';
  $('session-text').textContent = online ? state.message + (state.armed ? ` ${state.remaining}s remaining.` : '') : preview ? 'Connect directly to the ESP32 to run a test.' : 'Output state unknown. The board stops an armed test after ten seconds without heartbeat.';
}
async function request(path, data) {
  const options = {cache:'no-store', signal:AbortSignal.timeout(3000)};
  if (data !== undefined) {
    options.method = 'POST';
    options.headers = {'X-Bench-Token':state?.token || '', 'Content-Type':'application/x-www-form-urlencoded'};
    options.body = new URLSearchParams(data);
  }
  const response = await fetch('/api/'+path, options);
  const body = await response.json();
  if (!response.ok) throw new Error(body.error || 'Board rejected the request.');
  if (typeof body.token !== 'string' || typeof body.armed !== 'boolean') throw new Error('Invalid board response.');
  state = body; online = true;
}
async function command(path, data={}) {
  if (preview || busy || !online) return;
  busy = true; $('feedback').textContent = ''; render();
  try { if (pollRequest) await pollRequest; await request(path,data); }
  catch (error) { online = false; $('feedback').textContent = error.message+' Reconnect to the board before continuing.'; }
  finally { busy = false; render(); }
}
async function poll() {
  if (preview || busy || polling || document.hidden) return;
  polling = true;
  try {
    pollRequest = request(online && state?.armed ? 'heartbeat' : 'state', online && state?.armed ? {} : undefined);
    await pollRequest;
  }
  catch { online = false; }
  finally { polling = false; pollRequest = null; render(); }
}
$('arm').addEventListener('click',()=>command('arm'));
$('stop').addEventListener('click',()=>command('stop'));
for (const channel of ['upper','lower']) {
  const card = document.querySelector(`[data-channel="${channel}"]`);
  card.querySelectorAll('[data-duty]').forEach(button => button.addEventListener('click',()=>command('fan',{channel,percent:button.dataset.duty})));
  $(channel+'-duty').addEventListener('input', event=>$(channel+'-choice').textContent=event.target.value+'%');
  card.querySelector('.apply').addEventListener('click',()=>command('fan',{channel,percent:$(channel+'-duty').value}));
}
function bestEffortStop() {
  if (preview || !state?.token || !state.armed) return;
  fetch('/api/stop',{method:'POST',headers:{'X-Bench-Token':state.token},body:'',keepalive:true}).catch(()=>{});
  online = false; render();
}
document.addEventListener('visibilitychange',()=>{ if(document.hidden) bestEffortStop(); else poll(); });
window.addEventListener('pagehide',bestEffortStop);
$('preview').hidden = !preview;
render(); poll(); setInterval(poll,2000);
</script>
</html>
)BENCHHTML";
